## buildroot-external/Config.in
```kconfig
menu "RTC Monitoring Appliance"

source "$BR2_EXTERNAL_RTC_MONITORING_PATH/package/rtc-health-monitor/Config.in"

endmenu
```

## buildroot-external/package/rtc-health-monitor/Config.in
```kconfig
config BR2_PACKAGE_RTC_HEALTH_MONITOR
	bool "rtc-health-monitor"
	depends on BR2_USE_MMU
	help
	  Periodically records RTC, system time, uptime, memory, filesystem,
	  and network-link health to a persistent log.
```
